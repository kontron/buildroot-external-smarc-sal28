## Config.in
```kconfig
source "$BR2_EXTERNAL_SMARC_SAL28_PATH/package/altera-stapl/Config.in"
source "$BR2_EXTERNAL_SMARC_SAL28_PATH/package/smarc-sal28-rcw/Config.in"
source "$BR2_EXTERNAL_SMARC_SAL28_PATH/package/smarc-sal28-devicetree/Config.in"
source "$BR2_EXTERNAL_SMARC_SAL28_PATH/package/ls1028a-dp-firmware/Config.in"
source "$BR2_EXTERNAL_SMARC_SAL28_PATH/package/miitool/Config.in"
source "$BR2_EXTERNAL_SMARC_SAL28_PATH/package/tsntool/Config.in"
```

## configs/kontron_smarc_sal28_defconfig
```kconfig
BR2_aarch64=y
BR2_cortex_a72=y
BR2_TOOLCHAIN_BUILDROOT_GLIBC=y
BR2_KERNEL_HEADERS_4_14=y
BR2_ROOTFS_DEVICE_CREATION_DYNAMIC_EUDEV=y
BR2_ROOTFS_OVERLAY="$(BR2_EXTERNAL_SMARC_SAL28_PATH)/board/kontron/smarc-sal28/rootfs_overlay"
BR2_ROOTFS_POST_BUILD_SCRIPT="$(BR2_EXTERNAL_SMARC_SAL28_PATH)/board/kontron/smarc-sal28/post-build.sh"
BR2_ROOTFS_POST_IMAGE_SCRIPT="support/scripts/genimage.sh"
BR2_ROOTFS_POST_SCRIPT_ARGS="-c $(BR2_EXTERNAL_SMARC_SAL28_PATH)/board/kontron/smarc-sal28/genimage.cfg"
BR2_LINUX_KERNEL=y
BR2_LINUX_KERNEL_CUSTOM_GIT=y
BR2_LINUX_KERNEL_CUSTOM_REPO_URL="https://source.codeaurora.org/external/qoriq/qoriq-components/linux"
BR2_LINUX_KERNEL_CUSTOM_REPO_VERSION="ls1028a-early-access-bsp0.3"
BR2_LINUX_KERNEL_PATCH="$(BR2_EXTERNAL_SMARC_SAL28_PATH)/board/kontron/smarc-sal28/linux-patches/"
BR2_LINUX_KERNEL_USE_ARCH_DEFAULT_CONFIG=y
BR2_LINUX_KERNEL_CONFIG_FRAGMENT_FILES="$(BR2_EXTERNAL_SMARC_SAL28_PATH)/board/kontron/smarc-sal28/linux.config"
BR2_LINUX_KERNEL_DTS_SUPPORT=y
BR2_LINUX_KERNEL_CUSTOM_DTS_PATH="$(BR2_EXTERNAL_SMARC_SAL28_PATH)/board/kontron/smarc-sal28/sl28.dts"
BR2_LINUX_KERNEL_DTB_OVERLAY_SUPPORT=y
BR2_PACKAGE_BUSYBOX_CONFIG_FRAGMENT_FILES="$(BR2_EXTERNAL_SMARC_SAL28_PATH)/board/kontron/smarc-sal28/busybox.config"
BR2_PACKAGE_ALSA_UTILS=y
BR2_PACKAGE_ALSA_UTILS_APLAY=y
BR2_PACKAGE_ALSA_UTILS_SPEAKER_TEST=y
BR2_PACKAGE_MPG123=y
BR2_PACKAGE_FIO=y
BR2_PACKAGE_RAMSMP=y
BR2_PACKAGE_STRACE=y
BR2_PACKAGE_STRESS=y
BR2_PACKAGE_MMC_UTILS=y
BR2_PACKAGE_MTD=y
# BR2_PACKAGE_MTD_FLASHCP is not set
BR2_PACKAGE_MTD_FLASH_OTP_DUMP=y
BR2_PACKAGE_MTD_FLASH_OTP_INFO=y
BR2_PACKAGE_MTD_FLASH_OTP_LOCK=y
BR2_PACKAGE_MTD_FLASH_OTP_WRITE=y
# BR2_PACKAGE_MTD_MTD_DEBUG is not set
# BR2_PACKAGE_MTD_NANDDUMP is not set
# BR2_PACKAGE_MTD_NANDTEST is not set
# BR2_PACKAGE_MTD_NANDWRITE is not set
# BR2_PACKAGE_MTD_UBIATTACH is not set
# BR2_PACKAGE_MTD_UBICRC32 is not set
# BR2_PACKAGE_MTD_UBIDETACH is not set
# BR2_PACKAGE_MTD_UBIFORMAT is not set
# BR2_PACKAGE_MTD_UBIMKVOL is not set
# BR2_PACKAGE_MTD_UBINFO is not set
# BR2_PACKAGE_MTD_UBINIZE is not set
# BR2_PACKAGE_MTD_UBIRENAME is not set
# BR2_PACKAGE_MTD_UBIRMVOL is not set
# BR2_PACKAGE_MTD_UBIRSVOL is not set
# BR2_PACKAGE_MTD_UBIUPDATEVOL is not set
# BR2_PACKAGE_MTD_UBIBLOCK is not set
BR2_PACKAGE_MTD_TESTS=y
BR2_PACKAGE_MTD_FLASH_READTEST=y
BR2_PACKAGE_MTD_FLASH_SPEED=y
BR2_PACKAGE_MTD_FLASH_STRESS=y
BR2_PACKAGE_MTD_FLASH_TORTURE=y
BR2_PACKAGE_EDID_DECODE=y
BR2_PACKAGE_MEMTESTER=y
BR2_PACKAGE_PCIUTILS=y
BR2_PACKAGE_UBOOT_TOOLS=y
BR2_PACKAGE_UBOOT_TOOLS_FIT_SUPPORT=y
BR2_PACKAGE_UBOOT_TOOLS_FIT_SIGNATURE_SUPPORT=y
BR2_PACKAGE_UBOOT_TOOLS_MKIMAGE=y
BR2_PACKAGE_UBOOT_TOOLS_DUMPIMAGE=y
BR2_PACKAGE_USBUTILS=y
BR2_PACKAGE_DTC=y
BR2_PACKAGE_DTC_PROGRAMS=y
BR2_PACKAGE_BRIDGE_UTILS=y
BR2_PACKAGE_CAN_UTILS=y
BR2_PACKAGE_DROPBEAR=y
BR2_PACKAGE_ETHTOOL=y
BR2_PACKAGE_IPERF3=y
BR2_PACKAGE_IPROUTE2=y
BR2_PACKAGE_LINUXPTP=y
BR2_PACKAGE_NFACCT=y
BR2_PACKAGE_NFTABLES=y
BR2_PACKAGE_PHYTOOL=y
BR2_PACKAGE_RSYNC=y
BR2_PACKAGE_SOCAT=y
BR2_PACKAGE_TCPDUMP=y
BR2_PACKAGE_UTIL_LINUX_BINARIES=y
BR2_TARGET_ROOTFS_CPIO=y
BR2_TARGET_ROOTFS_CPIO_XZ=y
BR2_TARGET_ROOTFS_CPIO_UIMAGE=y
BR2_TARGET_ROOTFS_EXT2=y
BR2_TARGET_ROOTFS_EXT2_4=y
BR2_TARGET_UBOOT=y
BR2_TARGET_UBOOT_BUILD_SYSTEM_KCONFIG=y
BR2_TARGET_UBOOT_CUSTOM_GIT=y
BR2_TARGET_UBOOT_CUSTOM_REPO_URL="https://github.com/kontron/u-boot-smarc-sal28.git"
BR2_TARGET_UBOOT_CUSTOM_REPO_VERSION="$(shell git ls-remote https://github.com/kontron/u-boot-smarc-sal28.git master | awk '{ print $$1 }')"
BR2_TARGET_UBOOT_BOARD_DEFCONFIG="kontron_sl28"
BR2_TARGET_UBOOT_NEEDS_DTC=y
# BR2_TARGET_UBOOT_FORMAT_BIN is not set
BR2_TARGET_UBOOT_FORMAT_ELF=y
BR2_TARGET_UBOOT_FORMAT_CUSTOM=y
BR2_TARGET_UBOOT_FORMAT_CUSTOM_NAME="u-boot-with-spl.bin"
BR2_TARGET_UBOOT_BOOT_SCRIPT=y
BR2_TARGET_UBOOT_BOOT_SCRIPT_SOURCE="$(BR2_EXTERNAL_SMARC_SAL28_PATH)/board/kontron/smarc-sal28/boot.cmd"
BR2_PACKAGE_HOST_DOSFSTOOLS=y
BR2_PACKAGE_HOST_GENIMAGE=y
BR2_PACKAGE_HOST_MTOOLS=y
BR2_PACKAGE_ALTERA_STAPL=y
BR2_PACKAGE_SMARC_SAL28_RCW=y
BR2_PACKAGE_SMARC_SAL28_RCW_VARIANT="3-11_q"
BR2_PACKAGE_SMARC_SAL28_DEVICETREE=y
BR2_PACKAGE_LS1028A_DP_FIRMWARE=y
BR2_PACKAGE_PPA_GENERIC=y
BR2_PACKAGE_PPA_GENERIC_PLATFORM="ls1028"
BR2_PACKAGE_MIITOOL=y
```

## configs/sal28_defconfig
```kconfig
BR2_aarch64=y
BR2_cortex_a72=y
BR2_TOOLCHAIN_BUILDROOT_GLIBC=y
BR2_KERNEL_HEADERS_4_14=y
BR2_TARGET_GENERIC_ROOT_PASSWD="root"
BR2_ROOTFS_POST_BUILD_SCRIPT="$(BR2_EXTERNAL_SMARC_SAL28_PATH)/board/kontron/smarc-sal28/post-build.sh"
BR2_LINUX_KERNEL=y
BR2_LINUX_KERNEL_CUSTOM_GIT=y
BR2_LINUX_KERNEL_CUSTOM_REPO_URL="https://source.codeaurora.org/external/qoriq/qoriq-components/linux"
BR2_LINUX_KERNEL_CUSTOM_REPO_VERSION="ls1028a-early-access-bsp0.1"
BR2_LINUX_KERNEL_USE_ARCH_DEFAULT_CONFIG=y
BR2_LINUX_KERNEL_CONFIG_FRAGMENT_FILES="$(BR2_EXTERNAL_SMARC_SAL28_PATH)/board/kontron/smarc-sal28/linux.config"
BR2_LINUX_KERNEL_DTS_SUPPORT=y
BR2_LINUX_KERNEL_CUSTOM_DTS_PATH="$(BR2_EXTERNAL_SMARC_SAL28_PATH)/board/kontron/smarc-sal28/sl28.dts"
BR2_TARGET_ROOTFS_CPIO=y
BR2_TARGET_ROOTFS_CPIO_XZ=y
BR2_TARGET_ROOTFS_CPIO_UIMAGE=y
BR2_TARGET_UBOOT=y
BR2_TARGET_UBOOT_BUILD_SYSTEM_KCONFIG=y
BR2_TARGET_UBOOT_CUSTOM_GIT=y
BR2_TARGET_UBOOT_CUSTOM_REPO_URL="git://git.sab.local/sl28/u-boot.git"
BR2_TARGET_UBOOT_CUSTOM_REPO_VERSION="master"
BR2_TARGET_UBOOT_BOARD_DEFCONFIG="kontron_sl28"
BR2_TARGET_UBOOT_NEEDS_DTC=y
BR2_PACKAGE_LS1028A_DP_FIRMWARE=y
```

## package/altera-stapl/Config.in
```kconfig
config BR2_PACKAGE_ALTERA_STAPL
	bool "altera-stapl"
	select BR2_PACKAGE_LIBGPIOD
	help
	  Altera Jam STAPL Bytecode Player.
```

## package/keapi-ktool/Config.in
```kconfig
config BR2_PACKAGE_KEAPI_KTOOL
	bool "keapi-ktool"
	depends on BR2_PACKAGE_KEAPI
	help
	  Kontron Embedded API

comment "keapi-tools needs keapi"
	depends on !BR2_PACKAGE_KEAPI
```

## package/keapi/Config.in
```kconfig
config BR2_PACKAGE_KEAPI
	bool "keapi"
	depends on BR2_TOOLCHAIN_HAS_THREADS
	select BR2_PACKAGE_JANSSON
	select BR2_PACKAGE_LIBATASMART
	select BR2_PACKAGE_PCRE
	help
	  Kontron Embedded API

comment "keapi needs a toolchain w/ threads"
	depends on !BR2_TOOLCHAIN_HAS_THREADS
```

## package/kmod-sl28cpld/Config.in
```kconfig
config BR2_PACKAGE_KMOD_SL28CPLD
	bool "kmod-sl28cpld"
	depends on BR2_LINUX_KERNEL
	help
	  Kernel module for the CPLD on the SMARC-sAL28 module.
```

## package/ls1028a-dp-firmware/Config.in
```kconfig
config BR2_PACKAGE_LS1028A_DP_FIRMWARE
	bool "NXP Layerscape LS1028A DisplayPort firmware"
	help
	  Firmware for the DisplayPort controller on the NXP Layerscape
	  LS1028A.
```

## package/miitool/Config.in
```kconfig
config BR2_PACKAGE_MIITOOL
	bool "miitool"
	help
	  Handy tool to manipulate PHY registers.
```

## package/ppa-generic/Config.in
```kconfig
config BR2_PACKAGE_PPA_GENERIC
	bool "ppa-generic"
	help
	  Primary Protected Application (PPA), a resident EL3 firmware.

	  The following services are provided:
	    * EL3 initialization (v8 cores, GIC, Interconnect, SoC)
		* Secure monitor gateway
		* PSCI v0.2
		* AArch32 kernel support

if BR2_PACKAGE_PPA_GENERIC
config BR2_PACKAGE_PPA_GENERIC_VARIANT
	string "PPA variant"
	default "rdb"

config BR2_PACKAGE_PPA_GENERIC_PLATFORM
	string "PPA platform"

endif
```

## package/smarc-sal28-devicetree/Config.in
```kconfig
config BR2_PACKAGE_SMARC_SAL28_DEVICETREE
	bool "SMARC sAL28 devicetree and overlay fragments"
	help
	  The devicetree and overlay fragments for the SMARC sAL28 board.
```

## package/smarc-sal28-rcw/Config.in
```kconfig
config BR2_PACKAGE_SMARC_SAL28_RCW
	bool "SMARC sAL28 RCW"
	depends on BR2_PACKAGE_HOST_UBOOT_TOOLS
	help
	  The reset configuration word for the SMARC sAL28 board.
	  The user must choose one of the available options.
	  The corresponding binary is then copied to the images
	  output directory.

if BR2_PACKAGE_SMARC_SAL28_RCW
config BR2_PACKAGE_SMARC_SAL28_RCW_VARIANT
	string "RCW Variant"
	default "4-11_q"
	help
	  The suffix of the RCW filename without the ".bin" part.
	  Eg. setting this to "4-11_q" will use "sl28-4-11_q.bin".
endif

comment "smarc-sal28-rcw needs BR2_PACKAGE_HOST_UBOOT_TOOLS"
```

## package/smarc-sal28-uboot-update/Config.in
```kconfig
config BR2_PACKAGE_SMARC_SAL28_UBOOT_UPDATE
	bool "SMARC sAL28 Uboot Update"
	help
	  When selected the bootloader update package is built. This contains all
          binary image blobs required for bootloader and RCW update as well as
          the installation script that copies any of these data to its appropriate
          storage.
          The update package is stored as a FIT image. The installation script herein
          is sourced from u-boot CLI
          source ${loadaddr}:install
```

## package/smarc-sal28-uboot-update/src/sl28_uboot_update.its
```
/*
 * bundle the update script with necessary files in one itb blob.
 *
 * add '/incbin/' to data node to build from a shell outside the
 * buildroot environment.
 * Example:
 * data = /incbin/("./uboot_install.scr");
 */

/dts-v1/;

/ {
	description = "Update script";
	#address-cells = <1>;

	images {
		install {
			description = "Kontron SMARC sAL28 bootloader install script";
			data = "./uboot_install.scr";
			type = "script";
			arch = "arm";
			os = "u-boot";
			compression = "none";
			hash-1 {
				algo = "md5";
			};
		};
		rcw-1 {
			description = "sAL28 RCW 2-11__";
			data = "rcw/sl28-2-11__.bin";
			type = "firmware";
			compression = "none";
			destination = "i2c";
			hash-1 {
				algo = "md5";
			};
		};
		rcw-2 {
			description = "sAL28 RCW 2-1s__";
			data = "rcw/sl28-2-1s__.bin";
			type = "firmware";
			compression = "none";
			destination = "i2c";
			hash-1 {
				algo = "md5";
			};
		};
		rcw-3 {
			description = "sAL28 RCW 2-22__";
			data = "rcw/sl28-2-22__.bin";
			type = "firmware";
			compression = "none";
			destination = "i2c";
			hash-1 {
				algo = "md5";
			};
		};
		rcw-4 {
			description = "sAL28 RCW 3-11_q";
			data = "rcw/sl28-3-11_q.bin";
			type = "firmware";
			compression = "none";
			destination = "i2c";
			hash-1 {
				algo = "md5";
			};
		};
		rcw-5 {
			description = "sAL28 RCW 3-1s_q";
			data = "rcw/sl28-3-1s_q.bin";
			type = "firmware";
			compression = "none";
			destination = "i2c";
			hash-1 {
				algo = "md5";
			};
		};
		rcw-6 {
			description = "sAL28 RCW 3-22_q";
			data = "rcw/sl28-3-22_q.bin";
			type = "firmware";
			compression = "none";
			destination = "i2c";
			hash-1 {
				algo = "md5";
			};
		};
		rcw-7 {
			description = "sAL28 RCW 4-11_q";
			data = "rcw/sl28-4-11_q.bin";
			type = "firmware";
			compression = "none";
			destination = "i2c";
			hash-1 {
				algo = "md5";
			};
		};
		rcw-8 {
			description = "sAL28 RCW 4-1s_q";
			data = "rcw/sl28-4-1s_q.bin";
			type = "firmware";
			compression = "none";
			destination = "i2c";
			hash-1 {
				algo = "md5";
			};
		};
		rcw-9 {
			description = "sAL28 RCW 4-22_q";
			data = "rcw/sl28-4-22_q.bin";
			type = "firmware";
			compression = "none";
			destination = "i2c";
			hash-1 {
				algo = "md5";
			};
		};
		spi-flash {
			description = "sAL28 bootloader install image";
			data = "./spi-flash.img";
			type = "firmware";
			destination = "spi";
			offset = <0x0>;
			compression = "none";
			hash-1 {
				algo = "md5";
			};
		};
		u-boot {
			description = "sAL28 bootloader update image";
			data = "./u-boot-with-spl.bin";
			type = "firmware";
			destination = "spi";
			offset = <0x210000>;
			compression = "none";
			hash-1 {
				algo = "md5";
			};
		};
		dp-firmware {
			description = "sAL28 DP firmware image";
			data = "./ls1028a-dp-fw.bin";
			type = "firmware";
			destination = "spi";
			offset = <0x300000>;
			compression = "none";
			hash-1 {
				algo = "md5";
			};
		};
	};

	variants {
		valid_list ="v0 v1 v2 v3 v4 v5 v6 v7 v8 v9";
		v1 {
			description = "full SPI flash install with RCW sl28-2-11__";
			update_parts = "rcw-1 spi-flash";
		};
		v2 {
			description = "full SPI flash install with RCW sl28-2-1s__";
			update_parts = "rcw-2 spi-flash";
		};
		v3 {
			description = "full SPI flash install with RCW sl28-2-22__";
			update_parts = "rcw-3 spi-flash";
		};
		v4 {
			description = "full SPI flash install with RCW sl28-3-11_q";
			update_parts = "rcw-4 spi-flash";
		};
		v5 {
			description = "full SPI flash install with RCW sl28-3-1s_q";
			update_parts = "rcw-5 spi-flash";
		};
		v6 {
			description = "full SPI flash install with RCW sl28-3-22_q";
			update_parts = "rcw-6 spi-flash";
		};
		v7 {
			description = "full SPI flash install with RCW sl28-4-11_q";
			update_parts = "rcw-7 spi-flash";
		};
		v8 {
			description = "full SPI flash install with RCW sl28-4-1s_q";
			update_parts = "rcw-8 spi-flash";
		};
		v9 {
			description = "full SPI flash install with RCW sl28-4-22_q";
			update_parts = "rcw-9 spi-flash";
		};
		v0 {
			description = "u-boot and dp-firmware update with RCW sl28-3-11_q";
			update_parts = "rcw-4 u-boot dp-firmware";
		};
	};
};
```

## package/tsntool/Config.in
```kconfig
config BR2_PACKAGE_TSNTOOL
	bool "tsntool"
	select BR2_PACKAGE_LIBNL
	select BR2_PACKAGE_READLINE
	select BR2_PACKAGE_NCURSES
	select BR2_PACKAGE_CJSON
	help
	  tsntool is a tool to configure TSN funtionalities in user space.
	  It can be used for TSN endpoint and TSN switch using netlink
	  interface.
```
